// Host simulation of Occupancy-Sensors.ino - compiles the real firmware against stubs and runs scripted days
#include "Particle.h"
#include <map>

// Prototypes normally generated by the Particle preprocessor
void setup(); void loop(); bool timeToSleep(); bool readyToDisconnect(); void sensorControl(bool); void recordConnectionDetails();
void serviceSensorEvent(); void serviceDebounceEvent(); void sendEvent(); void UbidotsHandler(const char*, const char*);
void takeMeasurements(); bool isItSafeToCharge(); void getSignalStrength(); int getTemperature();
void outOfMemoryHandler(system_event_t, int); void sensorISR(); int setPowerConfig(); void loadSystemDefaults();
void checkSystemValues(); void makeUpParkHourStrings(); void makeUpStringMessages(); bool disconnectFromParticle();
int resetCounts(String); int hardResetNow(String); int sendNow(String); void resetEverything(); int setSolarMode(String);
int setVerboseMode(String); String batteryContextMessage(); int setOpenTime(String); int setCloseTime(String);
int setDebounceMin(String); int setLowPowerMode(String); void publishStateTransition(void); void fullModemReset(); void dailyCleanup();

#include FIRMWARE

// time_zone_fn.cpp / particle_fn.cpp replacements
bool isDSTusa() { return true; }                 // Scenario dates are in September
int setTimeZone(String) { return 1; }
int setDSTOffset(String) { return 1; }
bool meterParticlePublish() { return true; }

const int64_t TZ = -4 * 3600;                    // EDT (defaults: zone -5, DST +1)
int64_t L(int y, int mo, int d, int h, int mi, int s = 0) {   // Local wall time -> UTC seconds
  std::tm t{}; t.tm_year = y - 1900; t.tm_mon = mo - 1; t.tm_mday = d; t.tm_hour = h; t.tm_min = mi; t.tm_sec = s;
  return (int64_t)timegm(&t) - TZ;
}

SystemSleepResult simSleep(const SystemSleepConfiguration& c) {
  SIM.sleeps++;
  SystemSleepResult r;
  int64_t wakeMs = SIM.ms + c.durMs;
  bool pirCanWake = std::find(c.pins.begin(), c.pins.end(), SCK) != c.pins.end();
  while (SIM.pirNext < SIM.pir.size()) {
    int64_t tMs = (SIM.pir[SIM.pirNext] - SIM.epochBase) * 1000;
    if (tMs >= wakeMs) break;
    SIM.pirNext++;
    if (pirCanWake && SIM.sensorEnabled) { wakeMs = std::max(tMs, SIM.ms); r.pin = SCK; break; }   // Worst case: ISR does NOT fire on wake
  }
  SIM.ms = wakeMs;
  // Device OS 6.4.1 system_sleep.cpp:205 queues PowerManager::wakeup();
  // system_power_manager.cpp:469 calls initDefault(), whose handleCharging()
  // honors configured DISABLE_CHARGING, not a prior direct PMIC disableCharging().
  // Apply the reload immediately: one valid interleaving before app resumes.
  simWakePowerReload();
  return r;
}

void reboot(const char* why) {
  printf("L,%lld,REBOOT %s\n", (long long)simNow(), why);
  state = INITIALIZATION_STATE; oldState = INITIALIZATION_STATE;
#if HAS_V1901_GLOBALS
  if (std::string(why) != "System.reset") lastFailedConnection = 0;   // retained: survives System.reset, cleared by power-down
  hardResetRequested = false;
#endif
#if HAS_V1902_GLOBALS
  drainStartMs = 0;
  temperatureC = 20.0;
#endif
#if HAS_V1903_GLOBALS
  chargingAllowed = true;
#endif
  lastReportedTime = 0; sensorDetect = false; stayAwakeTimeStamp = 0; stayAwake = 0; dataInFlight = false; outOfMemory = -1;
  systemStatusWriteNeeded = currentStatusWriteNeeded = false;
  current = currentStatus_structure(); memset(&sysStatus, 0, sizeof sysStatus); config = SystemSleepConfiguration();
  SIM.isr = nullptr; SIM.sensorEnabled = false; SIM.particleConnected = SIM.connecting = SIM.cellularOn = false; SIM.respAtMs.clear();
  SimSystem::resetReasonValue = RESET_REASON_USER;
  setup();
}

std::vector<int64_t> rebootAt;
std::pair<int64_t,int64_t> netDown{0, 0};
std::pair<int64_t,int64_t> queueFailureWindow{0, 0};
int64_t hardResetAt = 0;
void processTimedInputs() {
  simHardwareTick();
  while (SIM.pirNext < SIM.pir.size() && SIM.pir[SIM.pirNext] <= simNow()) { if (SIM.isr && SIM.sensorEnabled) SIM.isr(); SIM.pirNext++; }
  for (size_t i = 0; i < SIM.respAtMs.size();) { if (SIM.ms >= SIM.respAtMs[i]) { UbidotsHandler("resp", "201"); SIM.respAtMs.erase(SIM.respAtMs.begin() + i); } else i++; }
  if (netDown.first) SIM.networkUp = !(simNow() >= netDown.first && simNow() < netDown.second);
  if (netDown.first && !SIM.networkUp) SIM.particleConnected = false;
  if (netDown.first && simNow() >= netDown.second && SIM.netUpAt == 0) SIM.netUpAt = simNow();
  if (queueFailureWindow.first) PublishQueuePosix::instance().setPausePublishing(simNow() >= queueFailureWindow.first && simNow() < queueFailureWindow.second);
  PublishQueuePosix::instance().loop(); // Real queue has a background publisher.
  if (SIM.cellularOn && Particle.connected() && !SIM.pending.empty()) {
    if (SIM.connectedPendingSinceMs < 0) SIM.connectedPendingSinceMs = SIM.ms;
    SIM.maxConnectedPendingMs = std::max(SIM.maxConnectedPendingMs, SIM.ms - SIM.connectedPendingSinceMs);
  } else SIM.connectedPendingSinceMs = -1;
}
void checkpointPower() {
  SIM.powerChecks.push_back({SIM.ms, SIM.pmicMinV, SIM.pmicChargeV, SIM.pmicChargeCurrent});
}
void runUntil(int64_t untilUtc) {
  while (simNow() < untilUtc) {
    try {
      while (!rebootAt.empty() && simNow() >= rebootAt.front()) { rebootAt.erase(rebootAt.begin()); reboot("scripted"); }
      processTimedInputs();
      if (hardResetAt && simNow() >= hardResetAt) { hardResetAt = 0; SIM.cellularOn = true; hardResetNow("1"); }   // Console function call with the modem on
      loop();
      checkpointPower();
      simAdvance(100);
    } catch (SimReboot& r) { reboot(r.why.c_str()); }
  }
}

void addBurst(int64_t from, int64_t to, int every) { for (int64_t t = from; t <= to; t += every) SIM.pir.push_back(t); }

void emitTrace(bool focused, bool solar) {
  printf("META,%d,%d,%lld,%s\n", focused, solar, (long long)simNow(), currentPointRelease);
  printf("CFG,%d,%d,%d,%lld\n", sysStatus.openTime, sysStatus.closeTime, current.debounceMin, (long long)TZ);
  for (auto t : SIM.pir) printf("P,%lld\n", (long long)t);
  for (auto& r : SIM.queued) if (r.event == "Ubidots-Sensor-Hook-v1") printf("R,%lld,%s\n", (long long)r.t, r.data.c_str());
  for (auto& l : SIM.log) if (l.text.find("daily cleanup") != std::string::npos || l.text.find("Resetting everything") != std::string::npos || l.text.find("Captured reset") != std::string::npos) printf("L,%lld,%s\n", (long long)l.t, l.text.c_str());
  for (size_t i = 0; i < SIM.delivered.size() && i < SIM.queued.size(); i++)
    if (SIM.queued[i].event == "Ubidots-Sensor-Hook-v1") printf("X,%lld,%lld\n", (long long)SIM.queued[i].t, (long long)SIM.delivered[i].t);
  for (auto t : SIM.modemOn) printf("M,%lld\n", (long long)t);
  for (auto& c : SIM.chargingChanges) printf("CH,%lld,%d,%d,%s\n", (long long)c.ms, c.adc, c.enabled, c.cause.c_str());
  for (auto& c : SIM.powerConfigs) printf("PC,%lld,%d,%d,%d\n", (long long)c.ms, c.minV, c.chargeV, c.chargeCurrent);
  // Only changed stable checkpoints need serialization, but every loop is inspected.
  SimPowerConfig previous{-1,-1,-1,-1};
  for (auto& c : SIM.powerChecks) {
    if (c.minV != previous.minV || c.chargeV != previous.chargeV || c.chargeCurrent != previous.chargeCurrent)
      printf("PS,%lld,%d,%d,%d\n", (long long)c.ms, c.minV, c.chargeV, c.chargeCurrent);
    previous = c;
  }
  for (auto& cut : SIM.powerCuts) printf("PD,%lld,%d\n", (long long)cut.first, cut.second);
  printf("ST,%lld,%d,%d,%d,%d\n", (long long)SIM.maxConnectedPendingMs, SIM.waitTimeouts, SIM.sleeps, SIM.offRequests, SIM.powerDownAttempts);
  printf("PM,%d,%d,%d,%d\n", SIM.pmicMinV, SIM.chargingEnabled, SIM.uncleanPowerDowns, current.temperature);
  printf("N,%lld\n", (long long)SIM.netUpAt);
  printf("D,%zu,%zu\n", SIM.delivered.size(), SIM.pending.size());
}

bool runFocused(const std::string& sc) {
  if (sc != "boundary" && sc != "boundarylow" && sc != "boundaryfailed" && sc != "boundaryclosing" && sc != "stuckqueue" && sc != "stuckqueueboundary" && sc != "hotboot" && sc != "staledrain" && sc != "adc45" && sc != "chargecycle" && sc != "thermalhysteresis" && sc != "shutdownfail" && sc != "shutdownslow" && sc != "shutdownpowerfail" && sc != "shutdownerror12" && sc != "shutdownerror13") return false;
  SIM.epochBase = L(2026, 9, 29, 6, 59, 20);
  if (sc == "boundarylow") SIM.epochBase = L(2026, 9, 29, 8, 59, 20);
  if (sc == "boundaryclosing") SIM.epochBase = L(2026, 9, 29, 20, 59, 20);
  if (sc == "boundaryfailed") SIM.epochBase = L(2026, 9, 29, 6, 48, 20);
  if (sc == "stuckqueue") SIM.epochBase = L(2026, 9, 29, 6, 10); // Isolate one drain from clock-hour reconnect policy.
  if (sc == "staledrain") SIM.epochBase = L(2026, 9, 29, 20, 50);
  SIM.soc = 60;
  if (sc == "hotboot") {
    // A prior hot run persisted disable; reboot starts at the same hot ADC.
    SIM.adc = 1195;
    SIM.pmicChargeDisabled = true;
    SIM.chargingEnabled = false;
  }
  setup();
  checkpointPower();
  simTick = processTimedInputs;
  sysStatus.lowPowerMode = true;
  sysStatus.openTime = 6; sysStatus.closeTime = 21;
  if (sc == "boundary" || sc == "boundarylow" || sc == "boundaryclosing" || sc == "boundaryfailed") {
    if (sc == "boundarylow") {
      // Modem connected before SoC fell into the three-hour band.
      SIM.soc = 45; sysStatus.stateOfCharge = 45;
      SIM.cellularOn = SIM.particleConnected = true;
      SIM.modemOn.push_back(simNow());
      sysStatus.lastConnection = Time.now();
    }
    if (sc == "boundaryfailed") SIM.networkUp = false;
    state = REPORTING_STATE; oldState = IDLE_STATE; stayAwake = 1000;
    const int hour = sc == "boundarylow" ? 9 : sc == "boundaryclosing" ? 21 : 7;
    runUntil(L(2026, 9, 29, hour, sc == "boundaryfailed" ? 5 : 2));
  } else if (sc == "staledrain") {
    SIM.cellularOn = SIM.particleConnected = true;
    sysStatus.lastConnection = sysStatus.lastHookResponse = Time.now();
    state = IDLE_STATE; oldState = INITIALIZATION_STATE;
    PublishQueuePosix::instance().setPausePublishing(true);
    sendEvent(); readyToDisconnect(); // First drain starts while in LPM.
    setLowPowerMode("0");             // Console override while connected.
    PublishQueuePosix::instance().setPausePublishing(false);
    queueFailureWindow = {L(2026, 9, 29, 21, 0), L(2026, 9, 29, 21, 1)};
    runUntil(L(2026, 9, 29, 21, 2));
  } else if (sc == "stuckqueue" || sc == "stuckqueueboundary") {
    PublishQueuePosix::instance().setPausePublishing(true);
    SIM.cellularOn = SIM.particleConnected = true;
    sysStatus.lastConnection = sysStatus.lastHookResponse = Time.now();
    if (sc == "stuckqueueboundary") SIM.modemOn.push_back(simNow());
    current.debounceMin = 1; current.occupancyStatus = false;
    state = IDLE_STATE; oldState = INITIALIZATION_STATE;
    stayAwakeTimeStamp = millis(); stayAwake = 1000;
    sendEvent();
    readyToDisconnect(); // Begin one explicit drain episode; do not inspect/reset firmware timer globals.
    addBurst(simNow(), simNow() + 600, 65);
    runUntil(simNow() + 600);
  } else if (sc == "hotboot") {
    checkpointPower();
  } else if (sc == "adc45") {
    SIM.adc = 1191; takeMeasurements(); checkpointPower();
  } else if (sc == "chargecycle") {
    // Leave the final state safe so a final-state-only oracle misses the hot action.
    for (int adc : {881, 1191, 1195, 881}) { SIM.adc = adc; takeMeasurements(); checkpointPower(); simAdvance(100); }
  } else if (sc == "thermalhysteresis") {
    for (double c : {20.0, 43.1, 42.0, 40.1, 39.9}) {
      SIM.adc = int(std::lround((c / 100.0 + 0.5) * 4096.0 / 3.3));
      takeMeasurements(); checkpointPower(); simAdvance(100);
    }
  } else {
    SIM.cellularOn = SIM.particleConnected = true;
    SIM.cloudDisconnectDelayMs = 5000;
    SIM.offDelayMs = 20000;
    SIM.offFails = sc != "shutdownslow" && sc != "shutdownpowerfail";
    SIM.powerDownFails = sc == "shutdownpowerfail";
    state = IDLE_STATE;
    if (sc == "shutdownerror12" || sc == "shutdownerror13") {
      current.alerts = sc == "shutdownerror12" ? 12 : 13;
      state = ERROR_STATE; resetTimeStamp = millis(); simAdvance(31000);
    } else hardResetNow("1");
    const auto end = simNow() + 90;
    while (simNow() < end) {
      try { loop(); checkpointPower(); simAdvance(100); }
      catch (SimReboot& reset) { SIM.log.push_back({simNow(), "Captured reset " + reset.why}); break; } // Capture the reset without hiding it in a reboot fixture.
    }
  }
  emitTrace(true, false);
  return true;
}

int main(int argc, char** argv) {
  std::string sc = argc > 1 ? argv[1] : "base";
  const std::vector<std::string> scenarios = {"base", "connected", "lowbatt", "slowconn", "verylow", "nonet", "reboot", "hot", "hot115", "notchg", "badnet", "badnetlow", "hardreset", "solar", "solarhot", "solarnotchg", "boundary", "boundarylow", "boundaryfailed", "boundaryclosing", "stuckqueue", "stuckqueueboundary", "hotboot", "staledrain", "adc45", "chargecycle", "thermalhysteresis", "shutdownslow", "shutdownfail", "shutdownpowerfail", "shutdownerror12", "shutdownerror13"};
  if (std::find(scenarios.begin(), scenarios.end(), sc) == scenarios.end()) {
    fprintf(stderr, "unknown scenario: %s\n", sc.c_str()); return 2;
  }
  SIM.verbose = argc > 2;
  if (runFocused(sc)) return 0;
  SIM.epochBase = L(2026, 9, 29, 5, 30);        // Boot before opening (defaults open 6, close 21)
  // Day 1 - occupied at close
  SIM.pir.push_back(L(2026, 9, 29, 6, 15, 7));                      // Morning single event
  SIM.pir.push_back(L(2026, 9, 29, 7, 10, 3));                      // Single event: 5 min hold
  addBurst(L(2026, 9, 29, 8, 5, 11), L(2026, 9, 29, 8, 50, 11), 60);   // 45 min continuous: 15 min updates
  addBurst(L(2026, 9, 29, 9, 50, 13), L(2026, 9, 29, 10, 20, 13), 90); // Across the hour
  SIM.pir.push_back(L(2026, 9, 29, 12, 0, 31)); SIM.pir.push_back(L(2026, 9, 29, 12, 3, 31));   // Retrigger extends hold
  addBurst(L(2026, 9, 29, 20, 40, 17), L(2026, 9, 29, 21, 10, 17), 60); // Occupied through closing
  // Day 2 - unoccupied at close
  addBurst(L(2026, 9, 30, 10, 0, 5), L(2026, 9, 30, 10, 20, 5), 120);
  SIM.pir.push_back(L(2026, 9, 30, 20, 30, 9));
  std::sort(SIM.pir.begin(), SIM.pir.end());

  if (sc == "lowbatt") SIM.soc = 60;
  if (sc == "slowconn") { SIM.soc = 60; SIM.connectDelayMs = 45000; }   // Soak-like: 50-65% SoC, 45 s cellular connect
  if (sc == "verylow") SIM.soc = 45;
  if (sc == "hot") { SIM.soc = 60; SIM.adc = 1124; SIM.rawBatteryState = 2; }   // 105F enclosure on a sunny afternoon, PMIC charging
  if (sc == "hot115") { SIM.soc = 60; SIM.adc = 1195; SIM.rawBatteryState = 2; } // 115F - must still stop charging
  if (sc == "notchg") { SIM.soc = 60; SIM.rawBatteryState = 1; }                  // Genuinely not charging at 70F
  if (sc == "badnet" || sc == "badnetlow") { if (sc == "badnetlow") SIM.soc = 60; netDown = { L(2026, 9, 29, 7, 30), L(2026, 9, 29, 14, 0) }; }
  if (sc == "hardreset") hardResetAt = L(2026, 9, 29, 10, 30);                                      // <=50%: connect every third hour
  if (sc == "reboot") { rebootAt = { L(2026, 9, 29, 6, 20, 0), L(2026, 9, 29, 23, 30, 0), L(2026, 9, 30, 21, 0, 30) }; }

  const bool solar = sc.rfind("solar", 0) == 0;
  if (solar) {
    SIM.soc = 60;
    sysStatus = {}; sysStatus.solarPowerMode = true; sysStatus.lowPowerMode = true;
    sysStatus.timezone = -5; sysStatus.dstOffset = 1; sysStatus.openTime = 6; sysStatus.closeTime = 21;
    current = {}; current.debounceMin = 5; current.minBatteryLevel = 100;
    current.lastOccupancyChange = Time.now();
    const byte version = FRAMversionNumber;
    fram.put(FRAM::versionAddr, version);
    fram.put(FRAM::systemStatusAddr, sysStatus); fram.put(FRAM::currentStateAddr, current);
    if (sc == "solarhot") { SIM.adc = 1195; SIM.rawBatteryState = 2; }
    if (sc == "solarnotchg") SIM.rawBatteryState = 1;
  }

  setup();
  checkpointPower();
  simTick = processTimedInputs;
  if (sc == "connected") setLowPowerMode("0");
  if (sc == "nonet") { SIM.networkUp = false; runUntil(L(2026, 9, 29, 13, 0)); SIM.networkUp = true; SIM.netUpAt = simNow(); }
  runUntil(L(2026, 10, 1, 7, 0));

  emitTrace(false, solar);
}
